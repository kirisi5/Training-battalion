#include <reg51.h>

// ??1?
void delay1s()
{
	unsigned int i;
	
	// ?????1?????1
	TMOD = 0x20;
	TH1 = 0x3C; // 65536 - 50000 = 15536 (0x3C20)
	TL1 = 0x20;
	for (i = 0; i < 1000; i++) // ??????1??,??1000?
	{
		TR1 = 1; // ?????1
		while (!TF1); // ?????1??
		TF1 = 0; // ?????1????
	}
}

// ???
void main()
{
	unsigned char j, k, w;
	while (1)
	{
		for (j = 0; j < 3; j++) // ??8?,??????1?
		{
			P1 = 0x00; // ????LED
			delay1s(); // ??1?
			P1 = 0xFF; // ????LED
			delay1s(); // ??1?
		}
		// ????8?LED,??LED??1?
		w = 0x01;
		for (k = 0; k < 8; k++)
		{
			P1 = ~w; // ????LED
			delay1s(); // ??1?
			delay1s(); // ??1?
			w <<= 1; // ????,?????LED
		}
	}
}